## CMakeLists.txt
```
# SPDX-License-Identifier: Apache-2.0

cmake_minimum_required(VERSION 3.20.0)
find_package(Zephyr REQUIRED HINTS $ENV{ZEPHYR_BASE})
project(blinky)
set(CMAKE_CXX_STANDARD 20)
#set(CMAKE_CXX_FLAGS “-fmodules-ts”)
add_compile_options(-std=c++20) #-fmodules-ts -fext-numeric-literals)



target_sources(app PRIVATE src/main.cpp)
```

## prj.conf
```kconfig
CONFIG_GPIO=y
CONFIG_CPP=y
#CONFIG_LIBCPP_IMPLEMENTATION=y
#CONFIG_GLIBCXX_LIBCPP=y
CONFIG_REQUIRES_FULL_LIBCPP=y
```

## boards/stm32f103_min.overlay
```dts
 / { leds {
  compatible = "gpio-leds";
  green_led_1: led_1 {
    gpios = <&gpiob 12 GPIO_ACTIVE_LOW>;
    label = "User LD2";
  };
};
};
```

## src/main.cpp
```c
/*
 * Copyright (c) 2016 Intel Corporation
 *
 * SPDX-License-Identifier: Apache-2.0
 */

#include <zephyr/kernel.h>
#include <zephyr/drivers/gpio.h>
#include <vector>

//since C++20

/* 1000 msec = 1 sec */
#define SLEEP_TIME_MS   2000

/* The devicetree node identifier for the "led0" alias. */
#define LED0_NODE DT_ALIAS(led0)

/*
 * A build error on this line means your board is unsupported.
 * See the sample documentation for information on how to fix this.
 */

class led {

constexpr static const struct gpio_dt_spec red_led = GPIO_DT_SPEC_GET(LED0_NODE, gpios);
public:
  led()
  {
      if (!gpio_is_ready_dt(&red_led)) {
          printk("Failed to initialize");
      }
      auto ret = gpio_pin_configure_dt(&red_led, GPIO_OUTPUT_ACTIVE);
      if (ret < 0) {
          printk("something wrong happened");
      }
  }
  void toggle()
  {
      gpio_pin_toggle_dt(&red_led);
  }
};

int main(void)
{
  led led;
	while (1) {
		led.toggle();
		printk("Hello world\n");
		k_msleep(SLEEP_TIME_MS);
	}
	return 0;
}
```
